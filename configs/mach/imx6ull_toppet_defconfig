## configs/mach/imx6ull_toppet_defconfig
```kconfig
# Name:			imx6ull_toppet_defconfig
# Author: 		Yang Yujun
# E-mail:      	<yujiantianhu@163.com>
# Created on:  	2024.10.23
#
# Copyright (c) 2024   Yang Yujun <yujiantianhu@163.com>

# Generic
# ---------------------------------------------------------------
CONFIG_ARCH = "arm"
CONFIG_TYPE = "armv7"
CONFIG_CLASS = "cortex-a7"
CONFIG_VERDOR = "nxp"
CONFIG_CPU = "imx6ull"

# CONFIG_COMPILER = "arm-linux-gnueabihf-"
CONFIG_COMPILER = "arm-none-eabi-"

CONFIG_ARCH_ARMV7 = y
CONFIG_LITTILE_ENDIAN = y

CONFIG_MANUFACTURER = "TOPEET"
CONFIG_BOARD = "TERMINATOR_v1.1"

# float with hardware
CONFIG_VFP = y
# instruction: thumb or arm
CONFIG_INSTRUCTION = arm

# 0: amp; 1: smp
CONFIG_CORE = 0

# debug or release
CONFIG_BUILD_TYPE = release

# -O0, -O1, -O2
CONFIG_OPTIMIZE = 2

# Test control
CONFIG_TEST = n
# ---------------------------------------------------------------

# System Config
# Systick period = 1ms
CONFIG_HZ = 1000
CONFIG_HRTIMER_ENBALE = n

# ---------------------------------------------------------------
# Console
CONFIG_CONSOLE_DEVICE = "/dev/uart0"
# Use DMA to Receive or Send for Console ?
CONFIG_CONSOLE_RXDMA = n
CONFIG_CONSOLE_TXDMA = n

# Clock
# ---------------------------------------------------------------
# 24MHz
CONFIG_XTAL_FREQ_CLK = (24000000)
# 32.768KHz
CONFIG_RTC_FREQ_CLK = (32768)
# Cpu frequency
#CONFIG_CPU_FREQ = (528000000)
CONFIG_CPU_FREQ = (792000000)
# ---------------------------------------------------------------

# Memory
# ---------------------------------------------------------------
CONFIG_RAM_DDR_BASE = (0x80000000)
CONFIG_RAM_DDR_SIZE = (0x20000000)

# boot
# ---------------------------------------------------------------
# 120MB
CONFIG_PROGRAM_OFFSET = (0x07800000)

# RAM(->DDR) Configuration
# ---------------------------------------------------------------
# 0x80000000 ~ 0x801FFFFF: 2MB, reserved
# 0x80200000 ~ 0x805FFFFF: 4MB, early stack and params(global_data)
# 0x80600000 ~ 0x807FFFFF: 2MB, malloc len (early pool)
# 0x80800000 ~ 0x81FFFFFF: 24MB, params (boot -> kernel), extra memory reserved
# 0x82000000 ~ 0x82000FFF: 4KB, UND, stack
# 0x82001000 ~ 0x82200FFF: 2MB, FIQ, stack
# 0x82201000 ~ 0x82A00FFF: 8MB, IRQ, stack
# 0x82A01000 ~ 0x82A01FFF: 4KB, ABT, stack
# 0x82A02000 ~ 0x83201FFF: 8MB, SVC, stack
# 0x83202000 ~ 0x83401FFF: 2MB, SYS, stack
# 0x83402000 ~ 0x83C01FFF: 8MB, heap
# 0x83C02000 ~ 0x83C807FF: 7.9921875MB, reserved
# 0x84400000 ~ 0x85BFFFFF: 24MB, fixed data (such as fontlib, logo, ...)
# 0x85C00000 ~ 0x85FFFFFF: 4MB, reserved
# 0x86000000 ~ 0x863FFFFF: 4MB, device tree
# 0x86400000 ~ 0x877FEFFF: 19.99609375MB, reserved
# 0x877FF000 ~ 0x87800000: 4KB, IVT and DCD

CONFIG_PROGRAM_BASE = (CONFIG_RAM_DDR_BASE + CONFIG_PROGRAM_OFFSET)
CONFIG_PROGRAM_SIZE = (CONFIG_RAM_DDR_SIZE - CONFIG_PROGRAM_OFFSET)

CONFIG_BOARD_SP_ADDR = (0x80800000)
CONFIG_BOOT_MALLOC_LEN = (2 * 1024 * 1024)

CONFIG_B2K_PARAM_BASE = (CONFIG_BOARD_SP_ADDR)
CONFIG_B2K_PARAM_SIZE = (24 * 1024 * 1024)

CONFIG_DEVICE_TREE_BASE = (0x86000000)
CONFIG_FDT_MAX_SIZE = (4 * 1024 * 1024)

CONFIG_B2K_FIXDATA_BASE = (0x84400000)
CONFIG_B2K_FIXDATA_SIZE = (24 * 1024 * 1024)

# DMA buffer: 16MB
CONFIG_DMA_AREA_SIZE = (16 * 1024 * 1024)

# Framebuffer: 24MB
CONFIG_FB_DRAM_SIZE = (24 * 1024 * 1024)

# Socket buffer: 8MB
CONFIG_NETWORK_BUFF_SIZE = (8 * 1024 * 1024)
# ---------------------------------------------------------------

# kernel
# ---------------------------------------------------------------
# configure stack by .lds
CONFIG_STACK_WITH_LDS = y

CONFIG_SYS_STACK_SIZE = (2 * 1024 * 1024)
CONFIG_SVC_STACK_SIZE = (8 * 1024 * 1024)
CONFIG_ABT_STACK_SIZE = (4 * 1024)
CONFIG_IRQ_STACK_SIZE = (8 * 1024 * 1024)
CONFIG_FIQ_STACK_SIZE = (2 * 1024 * 1024)
CONFIG_UND_STACK_SIZE = (4 * 1024)
CONFIG_HEAP_SIZE 	  = (8 * 1024 * 1024)

CONFIG_STACK_BASE 	  = (CONFIG_BOARD_SP_ADDR 	+ CONFIG_B2K_PARAM_SIZE)
CONFIG_UND_STACK_BASE = (CONFIG_STACK_BASE      + CONFIG_UND_STACK_SIZE)
CONFIG_FIQ_STACK_BASE = (CONFIG_UND_STACK_BASE  + CONFIG_FIQ_STACK_SIZE)
CONFIG_IRQ_STACK_BASE = (CONFIG_FIQ_STACK_BASE  + CONFIG_IRQ_STACK_SIZE)
CONFIG_ABT_STACK_BASE = (CONFIG_IRQ_STACK_BASE  + CONFIG_ABT_STACK_SIZE)
CONFIG_SVC_STACK_BASE = (CONFIG_ABT_STACK_BASE  + CONFIG_SVC_STACK_SIZE)
CONFIG_SYS_STACK_BASE = (CONFIG_SVC_STACK_BASE  + CONFIG_SYS_STACK_SIZE)
CONFIG_HEAP_BASE 	  = (CONFIG_SYS_STACK_BASE)
# ---------------------------------------------------------------

# Kernel
# ---------------------------------------------------------------
CONFIG_CONTEXT_EX = n
# ---------------------------------------------------------------

# Board
# ---------------------------------------------------------------
CONFIG_LCD_PIXELBIT = (32)
# ---------------------------------------------------------------

# platform
# ---------------------------------------------------------------
CONFIG_OF = y
CONFIG_BLOCK_DEVICE = n
CONFIG_PINCTRL = y
CONFIG_MMC = y
CONFIG_UART = y
CONFIG_I2C = y
CONFIG_DMA = y
CONFIG_INPUTDEV = y
CONFIG_VIDEO = y
CONFIG_USB = y

# support multi framebuffer
CONFIG_FB_MULTI_SUPPORT = n
CONFIG_FBUFFER_NUM = 2
# ---------------------------------------------------------------

# drivers
# ---------------------------------------------------------------
CONFIG_CPU_IMX6 = y
CONFIG_CLOCK_IMX6 = y

# Gpio
CONFIG_GPIO_IMX6 = y
CONFIG_GPIO_IMX_LED = y

# Pinctrl
CONFIG_PINCTRL_IMX6 = y

# input
CONFIG_INPUT_IMX_KEY = y

# uart
CONFIG_UART_IMX6 = y

# i2c
CONFIG_I2C_IMX6 = y
CONFIG_I2C_AP3216C = y
CONFIG_I2C_AT24CXX = y
CONFIG_I2C_TSC2007 = y

# sdma
CONFIG_SDMA_IMX6 = y

# hdmi
CONFIG_HDMI_SIL9022A = y

# sd card
# for imx6ull, there are some errors with 4 bus width 
CONFIG_SDMMC_BUS_WIDTH = 1
# video
CONFIG_VIDEO_FB_IMX6 = y

# usb
CONFIG_USB_IMX6 = y
CONFIG_USB_GADGET_IMX6 = y
CONFIG_USB_IMX_MOUSE = y
# ---------------------------------------------------------------

# example
CONFIG_BUTTON_APP = y
CONFIG_DISPLAY_APP = y
CONFIG_ENV_MONITOR_APP = y
CONFIG_LIGHT_APP = y
CONFIG_TSC_APP = n

# end of file
```

## configs/mach/zynq7_microphase_defconfig
```kconfig
# Name:			zynq7_microphase_defconfig
# Author: 		Yang Yujun
# E-mail:      	<yujiantianhu@163.com>
# Created on:  	2024.10.23
#
# Copyright (c) 2024   Yang Yujun <yujiantianhu@163.com>

# Generic
# ---------------------------------------------------------------
CONFIG_ARCH = "arm"
CONFIG_TYPE = "armv7"
CONFIG_CLASS = "cortex-a9"
CONFIG_VERDOR = "xilinx"
CONFIG_CPU = "xc7z010"

CONFIG_COMPILER = "arm-linux-gnueabihf-"

CONFIG_ARCH_ARMV7 = y
CONFIG_LITTILE_ENDIAN = y

# float with hardware
CONFIG_VFP = y
# instruction: thumb or arm
CONFIG_INSTRUCTION = arm

# debug or release
CONFIG_BUILD_TYPE = debug

# -O0, -O1, -O2
CONFIG_OPTIMIZE_CLASS = 0
# ---------------------------------------------------------------

# System Config
# Systick period = 5ms
CONFIG_HZ = 200
CONFIG_HRTIMER_ENBALE = n

# Console
CONFIG_CONSOLE_DEVICE = "/dev/uart0"

# Clock */
# ---------------------------------------------------------------
# 24MHz
CONFIG_XTAL_FREQ_CLK = (24000000)
# 32.768KHz
CONFIG_RTC_FREQ_CLK = (32768)
# ---------------------------------------------------------------

# Memory */
# ---------------------------------------------------------------
CONFIG_RAM_DDR_BASE = (0x00100000)
CONFIG_RAM_DDR_SIZE = (0x0FF00000)
# ---------------------------------------------------------------

# boot
# ---------------------------------------------------------------
# 64MB
CONFIG_PROGRAM_OFFSET = (0x04000000)

# RAM(->DDR) Configuration
# ----------------< 64MB >-------------------------
# 0x00100000 ~ 0x002FFFFF: 2MB, reserved
# 0x00300000 ~ 0x006FFFFF: 4MB, early stack and params (global_data)
# 0x00700000 ~ 0x008FFFFF: 2MB, malloc len (early pool)
# 0x00900000 ~ 0x018FFFFF: 16MB, params (boot -> kernel), extra memory reserved
# 0x01900000 ~ 0x019003FF: 1KB, UND, stack
# 0x01900400 ~ 0x019403FF: 256KB, FIQ, stack
# 0x01940400 ~ 0x019803FF: 256KB, IRQ, stack
# 0x01980400 ~ 0x019807FF: 1KB, ABT, stack
# 0x01980800 ~ 0x01B807FF: 2MB, SVC, stack
# 0x01B80800 ~ 0x01D807FF: 2MB, SYS, stack
# 0x01D80800 ~ 0x020FFFFF: reserved
# 0x02100000 ~ 0x024FFFFF: 4MB, device tree
# 0x02500000 ~ 0x03CFFFFF: 24MB, fixed data (such as fontlib, logo, ...)
# 0x03D00000 ~ 0x040FFFFF: 4MB, reserved

CONFIG_PROGRAM_BASE = (CONFIG_RAM_DDR_BASE + CONFIG_PROGRAM_OFFSET)
CONFIG_PROGRAM_SIZE = (CONFIG_RAM_DDR_SIZE - CONFIG_PROGRAM_OFFSET)

CONFIG_BOARD_SP_ADDR = (0x00900000)
CONFIG_BOOT_MALLOC_LEN = (2 * 1024 * 1024)

CONFIG_B2K_PARAM_BASE = (CONFIG_BOARD_SP_ADDR)
CONFIG_B2K_PARAM_SIZE = (16 * 1024 * 1024)

CONFIG_DEVICE_TREE_BASE = (0x02100000)
CONFIG_FDT_MAX_SIZE = (4 * 1024 * 1024)

CONFIG_B2K_FIXDATA_BASE = (0x02500000)
CONFIG_B2K_FIXDATA_SIZE = (24 * 1024 * 1024)

# DMA buffer: 16MB
CONFIG_DMA_AREA_SIZE = (16 * 1024 * 1024)

# Framebuffer: 16MB
CONFIG_FB_DRAM_SIZE = (16 * 1024 * 1024)

# Socket buffer: 8MB
CONFIG_NETWORK_BUFF_SIZE = (8 * 1024 * 1024)
# ---------------------------------------------------------------

# kernel
# ---------------------------------------------------------------
# configure stack by .lds
CONFIG_STACK_WITH_LDS = y

CONFIG_SYS_STACK_SIZE = (2 * 1024 * 1024)
CONFIG_SVC_STACK_SIZE = (8 * 1024 * 1024)
CONFIG_ABT_STACK_SIZE = (4 * 1024)
CONFIG_IRQ_STACK_SIZE = (8 * 1024 * 1024)
CONFIG_FIQ_STACK_SIZE = (2 * 1024 * 1024)
CONFIG_UND_STACK_SIZE = (4 * 1024)
CONFIG_HEAP_SIZE 	  = (8 * 1024 * 1024)

CONFIG_STACK_BASE 	  = (CONFIG_BOARD_SP_ADDR 	+ CONFIG_B2K_PARAM_SIZE)
CONFIG_UND_STACK_BASE = (CONFIG_STACK_BASE      + CONFIG_UND_STACK_SIZE)
CONFIG_FIQ_STACK_BASE = (CONFIG_UND_STACK_BASE  + CONFIG_FIQ_STACK_SIZE)
CONFIG_IRQ_STACK_BASE = (CONFIG_FIQ_STACK_BASE  + CONFIG_IRQ_STACK_SIZE)
CONFIG_ABT_STACK_BASE = (CONFIG_IRQ_STACK_BASE  + CONFIG_ABT_STACK_SIZE)
CONFIG_SVC_STACK_BASE = (CONFIG_ABT_STACK_BASE  + CONFIG_SVC_STACK_SIZE)
CONFIG_SYS_STACK_BASE = (CONFIG_SVC_STACK_BASE  + CONFIG_SYS_STACK_SIZE)
# ---------------------------------------------------------------

# Kernel
# ---------------------------------------------------------------
CONFIG_CONTEXT_EX = n
# ---------------------------------------------------------------

# Board
# ---------------------------------------------------------------
CONFIG_LCD_PIXELBIT = (32)
# ---------------------------------------------------------------

# platform
# ---------------------------------------------------------------
CONFIG_OF = y
CONFIG_BLOCK_DEVICE = y
CONFIG_PINCTRL = y
CONFIG_MMC = y
CONFIG_UART = y
CONFIG_I2C = y
CONFIG_DMA = y
CONFIG_INPUTDEV = y
CONFIG_VIDEO = y
CONFIG_USB = y

# support multi framebuffer
CONFIG_FB_MULTI_SUPPORT = y
CONFIG_FBUFFER_NUM = 2
# ---------------------------------------------------------------

# drivers
# ---------------------------------------------------------------
CONFIG_CPU_ZYNQ = y
CONFIG_CLOCK_ZYNQ = y

CONFIG_SDK_LED_ZYNQ = y
CONFIG_SDK_HDMI_ZYNQ = y

CONFIG_SDK_GEM_ZYNQ = y

# ---------------------------------------------------------------

# example
CONFIG_BUTTON_APP = n
CONFIG_DISPLAY_APP = y
CONFIG_ENV_MONITOR_APP = n
CONFIG_LIGHT_APP = y
CONFIG_TSC_APP = n
CONFIG_CONSOLE_APP = y

CONFIG_NETWORK_TASK = y
CONFIG_LVGL_TASK = y

# end of file
```
